VERSION "merge-b"

NS_ :

BS_:
BU_: DUT DBG

BO_ 784 Merge_B: 1 DUT
 SG_ b_value : 0|8@1+ (1,0) [0|255] "" DBG

BO_ 769 Merge_Same: 2 DUT
 SG_ same_value : 0|16@1+ (0.1,0) [0|6553.5] "V" DBG

BO_ 770 Merge_Conflict_B: 2 DUT
 SG_ conflict_b : 0|16@1+ (1,0) [0|65535] "" DBG

BO_ 771 Merge_Dup: 2 DUT
 SG_ dup_value : 0|16@1+ (1,0) [0|65535] "" DBG

BO_ 820 Merge_Moved: 1 DUT
 SG_ moved_value : 0|8@1+ (1,0) [0|255] "" DBG
