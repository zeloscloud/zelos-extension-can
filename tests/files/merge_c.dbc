VERSION "merge-c"

NS_ :

BS_:
BU_: DUT DBG

BO_ 800 Merge_C: 1 DUT
 SG_ c_value : 0|8@1+ (1,0) [0|255] "" DBG
